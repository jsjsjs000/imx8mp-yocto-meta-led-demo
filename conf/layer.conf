## conf/layer.conf
```bitbake
# We have a conf and classes directory, add to BBPATH
BBPATH .= ":${LAYERDIR}"

# We have recipes-* directories, add to BBFILES
BBFILES += "${LAYERDIR}/recipes-*/*/*.bb \
            ${LAYERDIR}/recipes-*/*/*.bbappend"

BBFILE_COLLECTIONS += "meta-led-demo"
BBFILE_PATTERN_meta-led-demo = "^${LAYERDIR}/"
BBFILE_PRIORITY_meta-led-demo = "6"

LAYERDEPENDS_meta-led-demo = "core"
LAYERSERIES_COMPAT_meta-led-demo = "hardknott"

LICENSE_PATH += "${LAYERDIR}/licenses"
```
